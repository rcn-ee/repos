## xenomai/suite/bullseye/debian/xenomai-kernel-source/usr/src/xenomai-kernel-source/kernel/cobalt/arch/blackfin/Kconfig
```kconfig
config XENO_ARCH_FPU
	def_bool n

config XENO_ARCH_SYS3264
        def_bool n

source "kernel/xenomai/Kconfig"
source "drivers/xenomai/Kconfig"
```

## xenomai/suite/bullseye/debian/xenomai-kernel-source/usr/src/xenomai-kernel-source/kernel/cobalt/arch/powerpc/Kconfig
```kconfig
source "kernel/xenomai/Kconfig"
source "drivers/xenomai/Kconfig"

config IPIPE_WANT_ACTIVE_MM
        bool

config IPIPE_WANT_PREEMPTIBLE_SWITCH
        bool
	select IPIPE_WANT_ACTIVE_MM
	default y if XENO_ARCH_UNLOCKED_SWITCH
	default n if !XENO_ARCH_UNLOCKED_SWITCH

config XENO_ARCH_WANT_TIP
	bool

config XENO_ARCH_FPU
	def_bool PPC_FPU

config XENO_ARCH_SYS3264
        def_bool n

menu "Machine/platform-specific options"

config XENO_ARCH_UNLOCKED_SWITCH
	bool "Unlocked context switch"
	depends on IPIPE_HAVE_PREEMPTIBLE_SWITCH
	select XENO_ARCH_WANT_TIP
	default y
	help

	The Cobalt core may allow non-atomic execution of the
	machine-dependent context switching code, so that other CPUs
	and/or local interrupts may execute concurrently.

	This option reduces interrupt latency when costly cache and
	TLB flushes are required to switch context.
endmenu
```

## xenomai/suite/bullseye/debian/xenomai-kernel-source/usr/src/xenomai-kernel-source/kernel/cobalt/arch/x86/Kconfig
```kconfig
config XENO_ARCH_FPU
	def_bool y

config XENO_ARCH_SYS3264
        def_bool IA32_EMULATION

source "kernel/xenomai/Kconfig"
source "drivers/xenomai/Kconfig"
```
